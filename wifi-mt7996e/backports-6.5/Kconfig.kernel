## wifi-mt7996e/backports-6.5/drivers/net/wireless/mediatek/mt76/mt7921/Kconfig
```kconfig
# SPDX-License-Identifier: ISC
config MT7921_COMMON
	tristate
	depends on m
	select MT76_CONNAC_LIB
	select BPAUTO_WANT_DEV_COREDUMP

config MT7921E
	depends on !KERNEL_4_6
	tristate "MediaTek MT7921E (PCIe) support"
	depends on m
	select MT7921_COMMON
	depends on MAC80211
	depends on PCI
	help
	  This adds support for MT7921E 802.11ax 2x2:2SS wireless devices.

	  To compile this driver as a module, choose M here.

config MT7921S
	tristate "MediaTek MT7921S (SDIO) support"
	depends on m
	select MT76_SDIO
	select MT7921_COMMON
	depends on MAC80211
	depends on MMC
	help
	  This adds support for MT7921S 802.11ax 2x2:2SS wireless devices.

	  To compile this driver as a module, choose M here.

config MT7921U
	tristate "MediaTek MT7921U (USB) support"
	depends on m
	select MT76_USB
	select MT7921_COMMON
	depends on MAC80211
	depends on USB
	help
	  This adds support for MT7921U 802.11ax 2x2:2SS wireless devices.

	  To compile this driver as a module, choose M here.
```
